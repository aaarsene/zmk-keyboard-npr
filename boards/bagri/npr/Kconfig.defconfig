## boards/bagri/npr/Kconfig.defconfig
```kconfig
config BOARD
    default "npr"

if USB

config USB_NRFX
    default y

config USB_DEVICE_STACK
    default y

endif # USB

config BT_CTLR
    default BT

config ZMK_KEYBOARD_NAME
    default "NP-R"

choice ZMK_BOOTMODE_MAGIC_VALUE_BOOTLOADER_TYPE
    default ZMK_BOOTMODE_MAGIC_VALUE_BOOTLOADER_TYPE_ADAFRUIT_NRF52

endchoice
```

## boards/bagri/npr/npr_defconfig
```kconfig
CONFIG_CLOCK_CONTROL_NRF_K32SRC_RC=y

# Enable MPU
CONFIG_ARM_MPU=y

# enable GPIO
CONFIG_GPIO=y

CONFIG_PWM=y
CONFIG_LED_PWM=y

CONFIG_USE_DT_CODE_PARTITION=y
CONFIG_BUILD_OUTPUT_UF2=y

CONFIG_MPU_ALLOW_FLASH_WRITE=y
CONFIG_NVS=y
CONFIG_SETTINGS_NVS=y
CONFIG_FLASH=y
CONFIG_FLASH_PAGE_LAYOUT=y
CONFIG_FLASH_MAP=y

CONFIG_ZMK_USB=y
CONFIG_ZMK_BLE=y

CONFIG_ZMK_SLEEP=y
CONFIG_ZMK_IDLE_TIMEOUT=60000

CONFIG_ZMK_PM_SOFT_OFF=y
CONFIG_PM=y
CONFIG_PM_DEVICE=y
CONFIG_ZMK_EXT_POWER=y

CONFIG_LED_STRIP=y

CONFIG_ZMK_HID_INDICATORS=y

CONFIG_ZMK_STUDIO=y
CONFIG_ZMK_STUDIO_LOCKING=n

CONFIG_ZMK_USB_LOGGING=n

CONFIG_BT_CTLR_TX_PWR_PLUS_8=y
```

## config/west.yml
```yaml
manifest:
  remotes:
    - name: zmkfirmware
      url-base: https://github.com/zmkfirmware
  projects:
    - name: zmk-output-behavior-listener
      remote: badjeff
      revision: main
    - name: zmk-keyboards # used for the numlock led
      remote: joelspadin
      revision: main
```

## dts/bindings/behaviors/npr,behavior-status-leds.yaml
```yaml
description: NP-R Status LEDs Behavior

compatible: "npr,behavior-status-leds"

include: two_param.yaml
```
